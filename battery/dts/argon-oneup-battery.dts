/dts-v1/;
/plugin/;

/ {
	compatible = "raspberrypi,5-model-b";

	fragment@0 {
		target = <&i2c1>;
		__overlay__ {
			#address-cells = <1>;
			#size-cells = <0>;

			oneup_battery: battery@64 {
				compatible = "argon40,oneup-battery";
				reg = <0x64>;
			};
		};
	};
};
